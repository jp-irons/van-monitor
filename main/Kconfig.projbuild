## main/Kconfig.projbuild
```kconfig
menu "Van Monitor"

config VAN_MONITOR_DISPLAY_ENABLED
    bool "Enable display (ST7789T3 + CST816D touch)"
    default y
    help
        Enable the physical display and touch controller stack.
        Set to n to skip all display and touch initialisation — useful when
        developing without the target hardware connected. The web interface,
        API routes, water level sensor, and activity management all remain
        fully functional.

endmenu
```

## sdkconfig.defaults
```kconfig
CONFIG_PARTITION_TABLE_CUSTOM=y
CONFIG_PARTITION_TABLE_CUSTOM_FILENAME="partitions.csv"
CONFIG_BOOTLOADER_APP_ROLLBACK_ENABLE=y
CONFIG_MBEDTLS_X509_CREATE_C=y
CONFIG_ESP_MAIN_TASK_STACK_SIZE=8192
CONFIG_ESPTOOLPY_FLASHSIZE_16MB=y
CONFIG_ESPTOOLPY_FLASHMODE_QIO=y
CONFIG_LOG_DEFAULT_LEVEL_INFO=y
CONFIG_LOG_MAXIMUM_LEVEL_DEBUG=y
CONFIG_LWIP_MAX_SOCKETS=24
CONFIG_SPIRAM=y
CONFIG_SPIRAM_MODE_OCT=y
CONFIG_SPIRAM_SPEED_80M=y
CONFIG_SPIRAM_BOOT_INIT=y
CONFIG_SPIRAM_USE_MALLOC=y
CONFIG_SPIRAM_FETCH_INSTRUCTIONS=y
CONFIG_SPIRAM_RODATA=y
CONFIG_SPIRAM_TRY_ALLOCATE_WIFI_LWIP=y
CONFIG_MBEDTLS_DYNAMIC_BUFFER=y

# Power management — DFS max=160 MHz, min=80 MHz; prerequisite for light sleep
CONFIG_PM_ENABLE=y

# ── Display / touch (SpotPear ESP32-S3-Touch-LCD-2 target board) ──────────────
# These must be applied to sdkconfig when migrating from the dev board.
# SPI2 host is used for the ST7789T3 LCD (40 MHz, DMA enabled via SPI_DMA_CH_AUTO).
# I2C0 is used for the CST816D touch controller (400 kHz, GPIOs 15/7).
# LVGL frame buffers are allocated in PSRAM; DMA buffers remain in internal SRAM.
CONFIG_SPI_MASTER_ISR_IN_IRAM=y
CONFIG_LVGL_TASK_STACK_SIZE=8192
CONFIG_LVGL_TASK_PRIORITY=4

# LVGL Montserrat fonts used by the display component
# (lv_font_montserrat_14 is the LVGL default and usually enabled already)
CONFIG_LV_FONT_MONTSERRAT_10=y
CONFIG_LV_FONT_MONTSERRAT_12=y
CONFIG_LV_FONT_MONTSERRAT_14=y
CONFIG_LV_FONT_MONTSERRAT_16=y
CONFIG_LV_FONT_MONTSERRAT_22=y
CONFIG_LV_FONT_MONTSERRAT_28=y
```
